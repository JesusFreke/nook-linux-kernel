## arch/arm/mach-s3c6410/Kconfig
```kconfig
# arch/arm/mach-s3c6410/Kconfig
#
# Copyright 2008 Openmoko, Inc.
# Copyright 2008 Simtec Electronics
#
# Licensed under GPLv2

# Configuration options for the S3C6410 CPU

config CPU_S3C6410
	bool
	select CPU_S3C6400_INIT
	select CPU_S3C6400_CLOCK
	help
	  Enable S3C6410 CPU support

config S3C6410_SETUP_SDHCI
	bool
	help
	  Internal helper functions for S3C6410 based SDHCI systems
	  
menu "Samsung S3C6410 Implementations"

choice
	prompt "Select Machine"

config MACH_SMDK6410
	bool "SMDK6410"
	select CPU_S3C6410
	select S3C_DEV_HSMMC
	select S3C_DEV_HSMMC1
	select S3C_DEV_HSMMC2	
	select S3C6410_SETUP_SDHCI
	select S3C_DMA_PL080
#	select S3C_DEV_I2C1
#	select S3C64XX_SETUP_I2C1
	help
	  Machine support for the Samsung SMDK6410

config MACH_BRAVO
	bool "BRAVO"
	depends on MACH_SMDK6410
	help
	  Machine support for Intrinsyc Bravo platform

config MACH_BRAVO_PROTOTYPE
	bool "BRAVO_PROTOTYPE"
	depends on MACH_BRAVO
	help
	  Machine support for Intrinsyc Bravo platform PROTOTYPE HW version

config MACH_BRAVO_EVT1
	bool "BRAVO_EVT1"
	depends on MACH_BRAVO
	help
	  Machine support for Intrinsyc Bravo platform EVT1 HW version

config MACH_BRAVO_EVT15
	bool "BRAVO_EVT15"
	depends on MACH_BRAVO_EVT1
	help
	  Machine support for Bravo platform EVT15 HW version

config MACH_BRAVO_EVT2
	bool "BRAVO_EVT2"
	depends on MACH_BRAVO_EVT15
	help
	  Machine support for Bravo platform EVT2 HW version

config MACH_BRAVO_DVT
	bool "BRAVO_DVT"
	depends on MACH_BRAVO_EVT2
	help
	  Machine support for Bravo platform DVT HW version

config MACH_BRAVO_PROD
	bool "BRAVO_PROD"
	depends on MACH_BRAVO_DVT
	help
	  Machine support for Bravo platform product release

config MACH_BRAVO_NO_UART
	bool "BRAVO_NO_UART"
	depends on MACH_BRAVO_DVT
	help
	  Machine support for Bravo platform DVT with UART disabled

config MACH_BRAVO_RDU
	bool "BRAVO_RDU"
	depends on MACH_BRAVO_DVT
	help
	  Machine support for Bravo platform RDU HW version
	  
config BRAVO_WIFI_ONOFF
	bool "BRAVO_WIFI_ONOFF"
	depends on MACH_BRAVO_EVT2
	help
	  Enable or Disable WIFI Power

config MACH_BRAVO_I2C_MULTICLK
	bool "BRAVO_I2C_MULTICLK"
	depends on MACH_BRAVO
	help
	  Multiple I2C clk support on one I2C bus

config USBHOST_CLOCK_EPLL
	bool "USBHOST_CLOCK_EPLL"
	depends on MACH_BRAVO
	help
	  USBHOST1.1 Clock Source MOUTEPLL


config BRAVO_LOWBATT_WAKEUP
	bool "BRAVO_LOWBATT_WKUP"
	depends on MACH_BRAVO
	help
	  LowBattery Wakeup triggered by PMIC PCOMP_OFF_THR 

config MACH_BIGBANG
	bool "BIGBANG"
	select CPU_S3C6410
#	select S3C_DEV_HSMMC
#	select S3C_DEV_HSMMC1
#	select S3C_DEV_I2C1
#	select S3C6410_SETUP_SDHCI
#	select S3C64XX_SETUP_I2C1
#	select S3C_DMA_PL080
	help
	  Machine support for the Samsung BIGBANG

endchoice

# At least some of the SMDK6410s were shipped with the card detect
# for the MMC/SD slots connected to the same input. This means that
# either the boards need to be altered to have channel0 to an alternate
# configuration or that only one slot can be used.

choice
	prompt "SMDK6410 MMC/SD slot setup"
	depends on MACH_SMDK6410

config SMDK6410_SD_CH0
	bool "Use channel 0 only"
	depends on MACH_SMDK6410
	help
          Select CON7 (channel 0) as the MMC/SD slot, as
	  at least some SMDK6410 boards come with the
	  resistors fitted so that the card detects for
	  channels 0 and 1 are the same.
endchoice

choice
	prompt "SMDK6410 MMC/SD slot1 setup"
	depends on MACH_SMDK6410

config SMDK6410_SD_CH1
	bool "Use channel 1 only"
	depends on MACH_SMDK6410
	help
          Select CON6 (channel 1) as the MMC/SD slot, as
	  at least some SMDK6410 boards come with the
	  resistors fitted so that the card detects for
	  channels 0 and 1 are the same.

endchoice

choice
	prompt "SMDK6410 MMC/SD slot2 setup"
	depends on MACH_SMDK6410

config SMDK6410_SD_CH2
	bool "Use channel 2 only"
	depends on MACH_SMDK6410
	help
          Select CON6 (channel 2) as the MMC/SD slot, as
	  at least some SMDK6410 boards come with the
	  resistors fitted so that the card detects for
	  channels 0, 1 or 2 are the same.

endchoice

choice
	prompt "SMDK6410 Revision"
	depends on MACH_SMDK6410

config SMDK6410_REV02
	bool "SMDK6410 Rev0.2"
	depends on MACH_SMDK6410
	help
	  Select SMDK6410 sub revision number 

config SMDK6410_REV10
	bool "SMDK6410 Rev1.0"
	select TOUCHSCREEN_NEW
	depends on MACH_SMDK6410
	help
	  Select SMDK6410 sub revision number 

endchoice

config BOARD_REVISION
	hex "Select H/W Revision"
	depends on MACH_BIGBANG
	default "0x81"


endmenu
```

## drivers/android/Kconfig
```kconfig
menuconfig ANDROID
	tristate "Android version 1.0 back porting for android 2.6.27"
	help
	  Android version 1.0 back porting for android 2.6.27

if ANDROID

config ANDROID_POWER
	bool "Android power driver"
	depends on PM && RTC_CLASS
	default n

config ANDROID_POWER_STAT
	bool "Android power driver lock stats"
	depends on ANDROID_POWER
	default y

config ANDROID_POWER_ALARM
	bool "Android alarm driver"
	depends on ANDROID_POWER
	default y

#endmenu

endif # ANDROID
```

## drivers/media/video/samsung/scaler/Kconfig
```kconfig
#
# Makefile for JPEG CODEC device driver designed by Samsung Electronics 2007
# Woosung Chung <woosung2.jung@samsung.com>
#

config VIDEO_SCALER
	bool "S3C6410 SCALER device support"
	depends on VIDEO_SAMSUNG
```

## drivers/video/epson-13521/Kconfig
```kconfig
#
# Video configuration
#

menu "Epson S1D13521 Support"

config FB_EPSON_S1D13521
    tristate "S1D13521 Support"
    depends on FB
    default y
    select VIDEO_SCALER
    select VIDEO_G2D
    select FB_CFB_FILLRECT
    select FB_CFB_COPYAREA
    select FB_CFB_IMAGEBLIT
    ---help---
      This enables support for Epson S1D13521 controller.
         
config FB_EPSON_VIRTUAL_FRAMEBUFFER
    bool "Support for virtual frame buffer"
    depends on FB && FB_EPSON_S1D13521
    default y
    select FB_CFB_FILLRECT
    select FB_CFB_COPYAREA
    select FB_CFB_IMAGEBLIT
#    ---help---
#      The frame buffer device provides an abstraction for the graphics

config FB_EPSON_BLACK_AND_WHITE
    bool "Black & White Virtual Framebuffer"
    depends on FB_EPSON_S1D13521
    default y
    ---help---
      Select Yes for Black & White Virtual Framebuffer, No for 8 shades of gray	

config FB_EPSON_VIRTUAL_FRAMEBUFFER_FREQ
    depends on FB_EPSON_S1D13521
    int "Virtual Framebuffer update frequency (Hz)"
    default 4 
    ---help---
      The virtual frame buffer update frequency	

config FB_EPSON_PCI
    bool "EPSON PCI Support"
    depends on FB_EPSON_S1D13521 && PCI
    default n
    ---help---
      This enables support for Epson PCI evaluation boards
          
config FB_EPSON_GPIO_SMDK6410
    bool "Assume SMDK6410 + GPIO pins"
    depends on FB_EPSON_S1D13521 && (!FB_EPSON_PCI)
    default y
    ---help---
      Select Yes if porting for the Gumstix/Broadsheet Platform, otherwise select No.
     	
config FB_EPSON_HRDY_OK
    bool "The host interface supports HRDY signal"
    depends on FB_EPSON_S1D13521
    default y
    ---help---
      Select Yes if the host interface supports HRDY signal, otherwise select No.
      If the HRDY signal is not present, driver polls the register containing the 
      interface status bit when neccessary.    
	
config FB_EPSON_PROC
    bool "Create /proc device files"
    depends on FB_EPSON_S1D13521
    default y
    ---help---
      Enables registers i/o using procfs. Useful for debugging.  

config FB_EPSON_DEBUG_PRINTK
    bool "Enable printk() debugging text."
    depends on FB_EPSON_S1D13521
    default y
    ---help---
      This enables printk() function in video driver.
      This function writes text to kernel log file when video driver
      functions are called. Note that printk() functions which display
      error messages are never disabled.

config FB_EPSON_DEBUG_PRINTK_LEVEL
    depends on FB_EPSON_DEBUG_PRINTK
    int "Debug Level"
    default 1
    ---help---
      The level of debug information	

config FB_EPSON_SHOW_SETTINGS
    bool "Display configuration settings while compiling"
    depends on FB_EPSON_S1D13521
    default y
    ---help---
      At compile time, this shows video configuration settings as warning messages.

endmenu
```

## drivers/video/g3d/Kconfig
```kconfig
#
# G3D subsystem configuration
#

menu "G3D Support"

config G3D
	tristate "FIMG-3DSE"
	depends on CPU_S3C6410
	help
		FIMG-3D

endmenu
```
